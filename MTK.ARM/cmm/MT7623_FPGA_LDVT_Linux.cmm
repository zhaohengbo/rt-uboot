;winclear

&NR_CPUS=2

system.reset
SYSTEM.OPTION ENRESET ON
SYStem.Option ResBreak OFF
SYStem.Option WaitReset ON
SYStem.JtagClock 10.MHz
if &NR_CPUS==1
(
SYSTEM.CPU CortexA7MPCore
)
else
(
    SYStem.CPU CortexA7MPCore
)

if &NR_CPUS==1
(

    ;Setting Core debug register access
    SYStem.CONFIG CORENUMBER 1;
    SYSTEM.MULTICORE COREBASE 0x80070000
)
else
(

;Setting Core debug register access
	SYSTEM.CONFIG CORENUMBER 2;
	core.assign 1 2 
    SYSTEM.MULTICORE COREBASE 0x80070000 0x80072000;
)

SYStem.Up

; disable DABORT and PABORT breakpoint
tronchip.set dabort off
tronchip.set pabort off
tronchip.set undef off
tronchip.set irq off

; set_hw_breakpoint_by_def
; setting attribute of breakpoints
;Break.Select Program OnChip
;Break.Select Hll OnChip
;Break.Select Spot OnChip
;Break.Select Read OnChip
;Break.Select Write OnChip

;Debugsys
;ETM.PORTSIZE 16
;ETM.READWRITEBREAK OFF
;ETM.DataTrace OFF
;ETM.CONTEXTID 32
;TRACE.MODE.FIFO
;CTS.MODE MEMORY
;ETM.BBC ON
;TRACE.AUTOINIT ON
;PERF.METHOD TRACE
;PERF.SORT RATIO
;PERF.MODE FUNCTION

;/* special settings for MTV-5 */
;data.set AHB:0xf0800058 %long 0x80f00e00   ; means 0xE0000000 ~0xF0000000 will use AXI Master1 
;data.set AHB:0xf080000c %long 0x400
;data.set AHB:0xf080000c %long 0x0

; disable WDT
;d.s c:0x10000000 %le %long 0x22000024
d.s c:0x10007000 %le %long 0x22000064

; Init DDR
do MT7623_FPGA_DDR.cmm

&KernelPath="linux-3.4.x"

&RamdiskImg="mt7623_fpga_ldvt_ramdisk.img"
&PhyRamStart=0x80000000
;FIXED 1 rank, total 128M when Porting
&LimitRam=0x8000000
&KernelStart=&PhyRamStart+0x8000
&RamdiskStart=&PhyRamStart+0x04000000
&RamdiskSize=OS.FILE.SIZE(&RamdiskImg)
print "loading Linux image..."
;data.load.binary &KernelPath/out/arch/arm/boot/Image &KernelStart
data.load.binary \\172.23.109.103\tftpboot\james_vmlinux.bin &KernelStart

;print "loading ram disk"
;Data.LOAD.Binary &RamdiskImg &RamdiskStart /noclear /nosymbol /quad

print "loading bootloader..."
data.load.elf mt7623_fpga_bl.axf /gnu 

print "loading Linux kernel symbols..."
Data.LOAD.Elf &KernelPath/vmlinux /gnu /nocode

y.spath.reset
y.spath.srd &KernelPath/init
y.spath.srd &KernelPath/mm
y.spath.srd &KernelPath/kernel
y.spath.srd &KernelPath/kernel/irq
y.spath.srd &KernelPath/arch/arm/kernel
y.spath.srd &KernelPath/arch/arm/mm
y.spath.srd &KernelPath/arch/arm/lib
y.spath.srd &KernelPath/arch/arm/mach-mt6575
y.spath.srd &KernelPath/lib
y.spath.srd &KernelPath/drivers/serial
y.spath.srd &KernelPath/../mediatek/platform/mt7623/kernel/
y.spath.srd &KernelPath/kernel/fs

; Linux kernel init end

r.s r7 OS.FILE.SIZE(&RamdiskImg)
if &NR_CPUS==1
(
)
else
(
    core.select 1
    r.s pc 0x86000000
    core.select 0
    r.s pc 0x86000000
)

d.l
