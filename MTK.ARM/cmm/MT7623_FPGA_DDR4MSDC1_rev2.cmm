
&NR_RNKS=2
; EMI setting
if &NR_RNKS==2
(
D.S SD:0x10203000 %LE %LONG 0x0002A352; EMI_CONA
)
else
(
D.S SD:0x10203000 %LE %LONG 0x00002112; EMI_CONA
)
D.S SD:0x10203060 %LE %LONG 0x00000400; EMI_CONM
;D.S SD:0x102030E8 %LE %LONG 0x00000800; EMI_DFTB
;D.S SD:0x10203000 %LE %LONG 0x0002A35A; EMI_CONA
;D.S SD:0x10203060 %LE %LONG 0x00000700; EMI_CONM
;D.S SD:0x10203140 %LE %LONG 0x10402488; EMI_ARBI
;D.S SD:0x10203100 %LE %LONG 0x4010580e; EMI_ARBA
;D.S SD:0x10203110 %LE %LONG 0xffff5803; EMI_ARBC
;D.S SD:0x10203118 %LE %LONG 0x0601580e; EMI_ARBD
;D.S SD:0x10203120 %LE %LONG 0x40405003; EMI_ARBE
;D.S SD:0x10203128 %LE %LONG 0x8080500f; EMI_ARBF
;D.S SD:0x10203130 %LE %LONG 0x8080500f; EMI_ARBG
;D.S SD:0x10203148 %LE %LONG 0x00464f2f; EMI_ARBJ
;D.S SD:0x10203150 %LE %LONG 0x00720038; EMI_ARBK
;D.S SD:0x10203158 %LE %LONG 0x0808084d; EMI_SLCT

; DDRPHY setting
if &NR_RNKS==2
(
D.S SD:0x1000F110 %LE %LONG 0x00051192;
)
else
(
D.S SD:0x1000F110 %LE %LONG 0x00051180;
)
D.S SD:0x1000F048 %LE %LONG 0x0000110d;
D.S SD:0x1000F0D8 %LE %LONG 0x00500900;
D.S SD:0x1000F0E4 %LE %LONG 0x00000001;
D.S SD:0x1000F08c %LE %LONG 0x00000001;
D.S SD:0x1000F090 %LE %LONG 0x00000000;
D.S SD:0x1000F094 %LE %LONG 0x80000000;
D.S SD:0x1000F0DC %LE %LONG 0x83004004;
D.S SD:0x1000F0E0 %LE %LONG 0x01004004;
D.S SD:0x1000F0F0 %LE %LONG 0x00000000;
D.S SD:0x1000F0F4 %LE %LONG 0x01000000;
D.S SD:0x1000F168 %LE %LONG 0x00000080;
D.S SD:0x1000F0D8 %LE %LONG 0x00700900;
D.S SD:0x1000F004 %LE %LONG 0xF00487A2;
D.S SD:0x1000F07C %LE %LONG 0x900641c0;
D.S SD:0x1000F028 %LE %LONG 0xF1200F01;
D.S SD:0x1000F1E0 %LE %LONG 0x3001ebff;
D.S SD:0x1000F158 %LE %LONG 0x00000000;
D.S SD:0x1000F0e4 %LE %LONG 0x00000005;
wait 1.ms
D.S SD:0x1000F088 %LE %LONG 0x0000003F;
;D.S SD:0x100F11E4 %LE %LONG 0x00000001;
;D.S SD:0x100F11E4 %LE %LONG 0x00000000;
wait 1.ms
D.S SD:0x1000F088 %LE %LONG 0x00FF000A;
;D.S SD:0x100F11E4 %LE %LONG 0x00000001;
;D.S SD:0x100F11E4 %LE %LONG 0x00000000;
wait 1.ms
D.S SD:0x1000F088 %LE %LONG 0x00320001;
;D.S SD:0x100F11E4 %LE %LONG 0x00000001;
;D.S SD:0x100F11E4 %LE %LONG 0x00000000;
wait 1.ms
D.S SD:0x1000F088 %LE %LONG 0x00020002;
;D.S SD:0x100F11E4 %LE %LONG 0x00000001;
;D.S SD:0x100F11E4 %LE %LONG 0x00001100;
wait 1.ms
;D.S SD:0x1000F110 %LE %LONG 0x00111190;
D.S SD:0x1000F0E4 %LE %LONG 0x00000001;
D.S SD:0x1000F084 %LE %LONG 0x00000a56;
D.S SD:0x1000F00C %LE %LONG 0x00000000;
D.S SD:0x1000F000 %LE %LONG 0x45D84408;
D.S SD:0x1000F044 %LE %LONG 0xa8080401;
D.S SD:0x1000F1E8 %LE %LONG 0x00000510;
D.S SD:0x1000F008 %LE %LONG 0x03406340;
D.S SD:0x1000F010 %LE %LONG 0x00000000;
D.S SD:0x1000F0F8 %LE %LONG 0xEDCB000F;
D.S SD:0x1000F0FC %LE %LONG 0x27010000;

; DRAMC setting
if &NR_RNKS==2
(
D.S SD:0x10004110 %LE %LONG 0x00051192;
)
else
(
D.S SD:0x10004110 %LE %LONG 0x00051180;
)
D.S SD:0x10004048 %LE %LONG 0x0000110d;
D.S SD:0x100040D8 %LE %LONG 0x00500900;
D.S SD:0x100040E4 %LE %LONG 0x00000001;
D.S SD:0x1000408c %LE %LONG 0x00000001;
D.S SD:0x10004090 %LE %LONG 0x00000000;
D.S SD:0x10004094 %LE %LONG 0x80000000;
D.S SD:0x100040DC %LE %LONG 0x83004004;
D.S SD:0x100040E0 %LE %LONG 0x01004004;
D.S SD:0x100040F0 %LE %LONG 0x00000000;
D.S SD:0x100040F4 %LE %LONG 0x01000000;
D.S SD:0x10004168 %LE %LONG 0x00000080;
D.S SD:0x100040D8 %LE %LONG 0x00700900;
D.S SD:0x10004004 %LE %LONG 0xF00487A2;

; for 7623 dramc code update @6.21
;========================================
; D.S SD:0x1000407C %LE %LONG 0x900641c0;
D.S SD:0x1000407C %LE %LONG 0x900641d0; //0x900641c0->0x900641d0
D.S SD:0x10004080 %LE %LONG 0x00000400; //new added for 7623
;========================================

D.S SD:0x10004028 %LE %LONG 0xF1200F01;
D.S SD:0x100041E0 %LE %LONG 0x3001ebff;
D.S SD:0x10004158 %LE %LONG 0x00000000;
D.S SD:0x100040e4 %LE %LONG 0x00000005;
;wait 1.ms
D.S SD:0x10004088 %LE %LONG 0x0000003F;
D.S SD:0x100041E4 %LE %LONG 0x00000001;
D.S SD:0x100041E4 %LE %LONG 0x00000000;
D.S SD:0x100041E4 %LE %LONG 0x00000000;
D.S SD:0x100041E4 %LE %LONG 0x00000000;
D.S SD:0x100041E4 %LE %LONG 0x00000000;
D.S SD:0x100041E4 %LE %LONG 0x00000000;
D.S SD:0x100041E4 %LE %LONG 0x00000000;
D.S SD:0x100041E4 %LE %LONG 0x00000000;
D.S SD:0x100041E4 %LE %LONG 0x00000000;
D.S SD:0x100041E4 %LE %LONG 0x00000000;
D.S SD:0x100041E4 %LE %LONG 0x00000000;
;wait 1.ms
D.S SD:0x10004088 %LE %LONG 0x00FF000A;
D.S SD:0x100041E4 %LE %LONG 0x00000001;
D.S SD:0x100041E4 %LE %LONG 0x00000000;
D.S SD:0x100041E4 %LE %LONG 0x00000000;
D.S SD:0x100041E4 %LE %LONG 0x00000000;
D.S SD:0x100041E4 %LE %LONG 0x00000000;
D.S SD:0x100041E4 %LE %LONG 0x00000000;
D.S SD:0x100041E4 %LE %LONG 0x00000000;
D.S SD:0x100041E4 %LE %LONG 0x00000000;
D.S SD:0x100041E4 %LE %LONG 0x00000000;
D.S SD:0x100041E4 %LE %LONG 0x00000000;
D.S SD:0x100041E4 %LE %LONG 0x00000000;
;wait 1.ms
D.S SD:0x10004088 %LE %LONG 0x00320001;
D.S SD:0x100041E4 %LE %LONG 0x00000001;
D.S SD:0x100041E4 %LE %LONG 0x00000000;
D.S SD:0x100041E4 %LE %LONG 0x00000000;
D.S SD:0x100041E4 %LE %LONG 0x00000000;
D.S SD:0x100041E4 %LE %LONG 0x00000000;
D.S SD:0x100041E4 %LE %LONG 0x00000000;
D.S SD:0x100041E4 %LE %LONG 0x00000000;
D.S SD:0x100041E4 %LE %LONG 0x00000000;
D.S SD:0x100041E4 %LE %LONG 0x00000000;
D.S SD:0x100041E4 %LE %LONG 0x00000000;
D.S SD:0x100041E4 %LE %LONG 0x00000000;
;wait 1.ms
D.S SD:0x10004088 %LE %LONG 0x00020002;
D.S SD:0x100041E4 %LE %LONG 0x00000001;
D.S SD:0x100041E4 %LE %LONG 0x00001100;
D.S SD:0x100041E4 %LE %LONG 0x00000000;
D.S SD:0x100041E4 %LE %LONG 0x00000000;
D.S SD:0x100041E4 %LE %LONG 0x00000000;
D.S SD:0x100041E4 %LE %LONG 0x00000000;
D.S SD:0x100041E4 %LE %LONG 0x00000000;
D.S SD:0x100041E4 %LE %LONG 0x00000000;
D.S SD:0x100041E4 %LE %LONG 0x00000000;
D.S SD:0x100041E4 %LE %LONG 0x00000000;
D.S SD:0x100041E4 %LE %LONG 0x00000000;
;wait 1.ms
;D.S SD:0x10004110 %LE %LONG 0x00111190;
D.S SD:0x100040E4 %LE %LONG 0x00000001;
D.S SD:0x10004084 %LE %LONG 0x00000a56;
D.S SD:0x1000400C %LE %LONG 0x00000000;
D.S SD:0x10004000 %LE %LONG 0x45D84408;
D.S SD:0x10004044 %LE %LONG 0xa8080401;
D.S SD:0x100041E8 %LE %LONG 0x00000510;
D.S SD:0x10004008 %LE %LONG 0x03406340;
D.S SD:0x10004010 %LE %LONG 0x00000000;
D.S SD:0x100040F8 %LE %LONG 0xEDCB000F;
D.S SD:0x100040FC %LE %LONG 0x27010000;
